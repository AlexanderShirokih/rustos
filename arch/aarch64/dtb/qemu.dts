/dts-v1/;
/ {
  model = "qemu,virt-aarch64";
  #address-cells = <1>;
  #size-cells    = <1>;

  memory@40000000 {
    device_type = "memory";
    reg = <0x40000000 0x40000000>; /* 1 GiB RAM */
  };

  reserved-memory {
    #address-cells = <1>;
    #size-cells    = <1>;
    ranges;

    fb: framebuffer@80000000 {
      compatible = "simple-framebuffer";
      reg        = <0x80000000 0x00800000>; /* 8 MiB */
      width      = <800>;
      height     = <600>;
      stride     = <3200>;
      format     = "a8r8g8b8";
      status     = "okay";
    };
  };
};
